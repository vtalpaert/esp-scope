## main/Kconfig
```kconfig
menu "espScope Configuration"
    config LED_BUILTIN
        int "LED IO Pin"
        default 2
        help
            LED IO pin

    config BSP_CONFIG_GPIO
        int "Factory Reset Pin (GPIO)"
        default 9
        help
            GPIO pin number to hold low on boot to erase NVS (Factory Reset).
            Default is 9 (BOOT button on Seeed XIAO ESP32C6).

    config BOARD_SPECIFIC_INIT
        string "Name of file containing any board specific initialisation"
        default "boards/default.h"
        help
            If your board requires some specific initialization C code, place it in
            a file called "./boards/<your board name>.h" and set this to "./boards/your board name.h"
            Default is boards/default.h which is empty.

endmenu
```
